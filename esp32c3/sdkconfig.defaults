## esp32c3/sdkconfig.defaults
```kconfig
# ESP32-C3 BLE Mesh node defaults
CONFIG_IDF_TARGET="esp32c3"
CONFIG_BT_ENABLED=y
CONFIG_BT_BLUEDROID_ENABLED=y
CONFIG_BT_BLE_42_FEATURES_SUPPORTED=y
# CONFIG_BT_BLE_50_FEATURES_SUPPORTED is not set
CONFIG_BT_CTRL_SCAN_DUPL_TYPE_DATA_DEVICE=y
CONFIG_BT_CTRL_BLE_MESH_SCAN_DUPL_EN=y
CONFIG_BT_GATTS_SEND_SERVICE_CHANGE_MANUAL=y
CONFIG_BT_BTU_TASK_STACK_SIZE=4512
CONFIG_PARTITION_TABLE_SINGLE_APP_LARGE=y

CONFIG_BLE_MESH=y
CONFIG_BLE_MESH_NODE=y
# CONFIG_BLE_MESH_PB_GATT is not set
# CONFIG_BLE_MESH_GATT_PROXY_SERVER is not set
# CONFIG_BLE_MESH_PROXY is not set
CONFIG_BLE_MESH_SETTINGS=y
CONFIG_BLE_MESH_RELAY=y
CONFIG_BLE_MESH_FRIEND=y
CONFIG_BLE_MESH_TX_SEG_MSG_COUNT=10
CONFIG_BLE_MESH_RX_SEG_MSG_COUNT=10
CONFIG_BLE_MESH_MODEL_KEY_COUNT=3
CONFIG_BLE_MESH_MODEL_GROUP_COUNT=6
CONFIG_BLE_MESH_GENERIC_SERVER=y
```

## esp32s3/sdkconfig.defaults
```kconfig
# ESP32-S3 BLE Mesh gateway defaults
CONFIG_IDF_TARGET="esp32s3"
CONFIG_BT_ENABLED=y
CONFIG_BT_BLUEDROID_ENABLED=y
CONFIG_BT_BLE_42_FEATURES_SUPPORTED=y
# CONFIG_BT_BLE_50_FEATURES_SUPPORTED is not set
CONFIG_BT_CTRL_SCAN_DUPL_TYPE_DATA_DEVICE=y
CONFIG_BT_CTRL_BLE_MESH_SCAN_DUPL_EN=y
CONFIG_BT_BTU_TASK_STACK_SIZE=4512
CONFIG_BT_GATTS_SEND_SERVICE_CHANGE_MANUAL=y
CONFIG_PARTITION_TABLE_SINGLE_APP_LARGE=y

CONFIG_BLE_MESH=y
CONFIG_BLE_MESH_PROVISIONER=y
# CONFIG_BLE_MESH_PB_GATT is not set
# CONFIG_BLE_MESH_PROXY is not set
CONFIG_BLE_MESH_SETTINGS=y
CONFIG_BLE_MESH_MAX_PROV_NODES=10
CONFIG_BLE_MESH_PBA_SAME_TIME=1
CONFIG_BLE_MESH_ADV_BUF_COUNT=100
CONFIG_BLE_MESH_TX_SEG_MSG_COUNT=10
CONFIG_BLE_MESH_RX_SEG_MSG_COUNT=10
CONFIG_BLE_MESH_MODEL_KEY_COUNT=3
CONFIG_BLE_MESH_MODEL_GROUP_COUNT=6
CONFIG_BLE_MESH_CFG_CLI=y
CONFIG_BLE_MESH_GENERIC_ONOFF_CLI=y
```
